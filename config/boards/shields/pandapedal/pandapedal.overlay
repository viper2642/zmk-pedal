/ {

  
    chosen {
        zmk,kscan = &default_kscan;
    };

    default_kscan: kscan {
        compatible = "zmk,kscan-gpio-direct";
        label = "default_kscan";
 	wakeup-source;
        input-gpios =
            <&gpio0 11 (GPIO_ACTIVE_LOW | GPIO_PULL_UP)>,
            <&gpio1 00 (GPIO_ACTIVE_LOW | GPIO_PULL_UP)>,
 	    <&gpio0 24 (GPIO_ACTIVE_LOW | GPIO_PULL_UP)>,
            <&gpio0 22 (GPIO_ACTIVE_LOW | GPIO_PULL_UP)>;
    };

};